/*
 * ssd1306.c
 *
 *  Created on: Aug 16, 2026
 *      Author: cdh
 */

#include "ssd1306.h"
#include <string.h>

static const uint8_t init_cmds[] = {
		0xAE,			// Display OFF
		0x20, 0x00,		// Memory Address Mode: Horizontal
		0xB0,			// Start Page Address
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		0x8D, 0x14,
		0xAF
};

static const uint8_t font5x7[][5] = {
		0x00, 0x00, 0x00, 0x00, 0x00,// (space)
		0x00, 0x00, 0x5F, 0x00, 0x00,// !
		0x00, 0x07, 0x00, 0x07, 0x00,// "
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		0x08, 0x1C, 0x2A, 0x08, 0x08 // <-
};

static HAL_StatusTypeDef ssd1306_write_cmd(SSD1306_t *dev, uint8_t cmd){
	HAL_StatusTypeDef CmdRes = HAL_I2C_Mem_Write(dev->hi2c, dev->addr, SSD1306_CTRL_CMD, I2C_MEMADD_SIZE_8BIT, &cmd, sizeof(cmd), 100);

	return CmdRes;
}

static HAL_StatusTypeDef ssd1306_write_data(SSD1306_t *dev, uint8_t *data, uint16_t size){
	HAL_StatusTypeDef DataRes = HAL_I2C_Mem_Write(dev->hi2c, dev->addr, SSD1306_CTRL_DATA, I2C_MEMADD_SIZE_8BIT, data, size, 100);

	return DataRes;
}


HAL_StatusTypeDef SSD1306_UpdateScreen(SSD1306_t *dev){
	for(int i = 0; i < 8; i++){
		HAL_StatusTypeDef CmdRes;
		CmdRes = ssd1306_write_cmd(dev, 0xB0 + i);
		if(CmdRes != HAL_OK) return CmdRes;
		CmdRes = ssd1306_write_cmd(dev, 0x00);
		if(CmdRes != HAL_OK) return CmdRes;
		CmdRes = ssd1306_write_cmd(dev, 0x10);
		if(CmdRes != HAL_OK) return CmdRes;
		HAL_StatusTypeDef DataRes = ssd1306_write_data(dev, &dev->buffer[i * SSD1306_WIDTH], SSD1306_WIDTH);
		if(DataRes != HAL_OK) return DataRes;
	}

	return HAL_OK;
}

void SSD1306_Clear(SSD1306_t *dev){
	memset(dev->buffer, 0, sizeof(dev->buffer));
}

void SSD1306_WriteChar(SSD1306_t *dev, char ch){
	if(ch <= 31 || ch >= 127) ch = '?';
	uint8_t font_idx = ch - 32;
	uint16_t pos = dev->cursor_x + (dev->cursor_y / 8) * SSD1306_WIDTH;
	for(int j = 0; j < 5; j++){
		dev->buffer[pos + j] = font5x7[font_idx][j];
	}
	dev->cursor_x += 6;
}

void SSD1306_WriteString(SSD1306_t *dev, const char *str){
	while(*str){
		SSD1306_WriteChar(dev, *str);
		str++;
	}
}

void SSD1306_SetCursor(SSD1306_t *dev, uint8_t x, uint8_t y){
	dev->cursor_x = x;
	dev->cursor_y = y;
}

HAL_StatusTypeDef SSD1306_Init(SSD1306_t *dev, I2C_HandleTypeDef *hi2c, uint8_t addr){
	dev->hi2c = hi2c;
	dev->addr = addr;
	HAL_Delay(100);
	for(const uint8_t *cmd = init_cmds; cmd < init_cmds + (sizeof(init_cmds) / sizeof(init_cmds[0])); cmd++){
			HAL_StatusTypeDef CmdRes = ssd1306_write_cmd(dev, *cmd);
			if(CmdRes != HAL_OK){
				return CmdRes;
			}
	}
	SSD1306_Clear(dev);
	HAL_StatusTypeDef UpdateRes = SSD1306_UpdateScreen(dev);
	SSD1306_SetCursor(dev, 0, 0);

	return UpdateRes;
}
